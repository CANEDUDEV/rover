VERSION ""

NS_ :

BS_:

BU_:

BO_ 0x200 SENSOR_POWER: 2 Vector__XXX
 SG_ SENSOR_POWER_ADC_VALUE : 0|16@1+ (1,0) [0|0] "" Vector__XXX

BO_ 0x201 SERVO_CURRENT: 2 Vector__XXX
 SG_ SERVO_CURRENT_mA : 0|16@1+ (1,0) [0|0] "mA" Vector__XXX

BO_ 0x202 BAT_VOLTAGE: 2 Vector__XXX
 SG_ BAT_VOLTAGE_mV : 0|16@1+ (1,0) [0|0] "mV" Vector__XXX

BO_ 0x203 VCC_SERVO_VOLTAGE: 2 Vector__XXX
 SG_ VCC_SERVO_VOLTAGE_mV : 0|16@1+ (1,0) [0|0] "mV" Vector__XXX

BO_ 0x204 H_BRIDGE_WINDING_CURRENT: 2 Vector__XXX
 SG_ H_BRIDGE_WINDING_CURRENT_mA : 0|16@1+ (1,0) [0|0] "mA" Vector__XXX
