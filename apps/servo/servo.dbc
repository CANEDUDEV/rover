VERSION ""

NS_ :

BS_:

BU_:

BO_ 100 SENSOR_POWER: 2 Vector__XXX
 SG_ SENSOR_POWER_ADC_VALUE : 0|16@1+ (1,0) [0|0] "" Vector__XXX

BO_ 101 SERVO_CURRENT: 2 Vector__XXX
 SG_ SERVO_CURRENT_mA : 0|16@1+ (1,0) [0|0] "mA" Vector__XXX

BO_ 102 BAT_VOLTAGE: 2 Vector__XXX
 SG_ BAT_VOLTAGE_mV : 0|16@1+ (1,0) [0|0] "mV" Vector__XXX

BO_ 103 VCC_SERVO_VOLTAGE: 2 Vector__XXX
 SG_ VCC_SERVO_VOLTAGE_mV : 0|16@1+ (1,0) [0|0] "mV" Vector__XXX

BO_ 104 H_BRIDGE_WINDING_CURRENT: 2 Vector__XXX
 SG_ H_BRIDGE_WINDING_CURRENT_mA : 0|16@1+ (1,0) [0|0] "mA" Vector__XXX
